/dts-v1/;
/plugin/;

/ {
    compatible = "brcm,bcm2835";

    fragment@0 {
        target = <&i2c1>;
        __overlay__ {
            #address-cells = <1>;
            #size-cells = <0>;

            bmp280@76 {
                compatible = "leon,bmp280-pi";
                reg = <0x76>;
                status = "okay";
            };
        };
    };
};